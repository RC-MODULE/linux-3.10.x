## Documentation/devicetree/bindings/ion,physmem.txt
```
ION PhysMem Driver
#include <dt-bindings/ion,physmem.h>


ION PhysMem is a generic driver for ION Memory Manager that allows you to 
define ION Memory Manager heaps using device tree. This is mostly useful if 
your SoC has several 'special' regions (e.g. SRAM, dedicated memory banks, 
etc) that are present in the physical memory map and you want to add them to 
ION as heaps of memory. 


Examples: 

1. 256KiB On-chip SRAM used as ION DMA heap. reg range is treated as a physical
   address range

	ion_im0: ion@0x00100000 { 
	     compatible = "ion,physmem";
	     reg = <0x00100000 0x40000>;
	     reg-names = "memory";
	     ion-heap-id   = <2>;
	     ion-heap-type = <ION_HEAP_TYPE_DMA>;
	     ion-heap-align = <0x10>;		     
	     ion-heap-name = "IM0";
	};

2. The same, but using system DMA memory. 

	ion_dma: ion@0xdeadbeef { 
	     compatible = "ion,physmem";
	     ion-heap-id   = <2>;
	     ion-heap-type = <ION_HEAP_TYPE_DMA>;
	     ion-heap-align = <0x10>;		     
	     ion-heap-name = "SYSDMA";
	};

2. Carveout heap, 1MiB size, ion-physmem will alloc pages for it using 
   alloc_pages_exact(). reg range is used for specifying size only.

		ion_crv: ion@deadbeef {
		     compatible = "ion,physmem";
		     reg = <0x00000000 0x100000>;
		     reg-names = "memory";
		     ion-heap-id   = <3>;
		     ion-heap-type = <ION_HEAP_TYPE_CARVEOUT>;
		     ion-heap-align = <0x10>;
		     ion-heap-name = "carveout";
		};

3. Chunk heap. 1MiB size, ion-physmem will alloc pages for it using 
   alloc_pages_exact(). reg range is used for specifying size only.

	ion_chunk: ion@0xdeadbeef { 
	     compatible = "ion,physmem";
	     ion-heap-id   = <2>;
	     ion-heap-type = <ION_HEAP_TYPE_CHUNK>;
	     ion-heap-align = <0x10>;		     
	     ion-heap-name = "chunky";
	};


4. vmalloc();

	ion_chunk: ion@0xdeadbeef { 
	     compatible = "ion,physmem";
	     ion-heap-id   = <2>;
	     ion-heap-type = <ION_HEAP_TYPE_SYSTEM>;
	     ion-heap-align = <0x10>;		     
	     ion-heap-name = "sys";
	};

5. kmalloc();

	ion_chunk: ion@0xdeadbeef { 
	     compatible = "ion,physmem";
	     ion-heap-id   = <2>;
	     ion-heap-type = <ION_HEAP_TYPE_SYSTEM_CONTIG>;
	     ion-heap-align = <0x10>;		     
	     ion-heap-name = "syscont";
	};
```

## arch/arm/configs/1888bc048_defconfig
```kconfig
CONFIG_ARM=y
CONFIG_ARCH_RCM_ARM=y
CONFIG_TARGET_1888BC048=y
CONFIG_SERIAL_MUART=y 
CONFIG_SERIAL_MUART_CONSOLE=y 
CONFIG_ARM_AMBA=y
CONFIG_MMC=y
CONFIG_MMC_RCM=y
CONFIG_SPI=y
CONFIG_SPI_MASTER=y
CONFIG_NETDEVICES=y
CONFIG_NET=y
CONFIG_ETHERNET=y
CONFIG_PACKET=y
CONFIG_UNIX=y
CONFIG_INET=y
CONFIG_IP_PNP=y
CONFIG_IP_PNP_DHCP=y
CONFIG_IP_PNP_BOOTP=y
CONFIG_DEVTMPFS=y
CONFIG_DEVTMPFS_MOUNT=y
CONFIG_OF=y
CONFIG_OF_MDIO=y
CONFIG_HIGHMEM=y
CONFIG_EMBEDDED=y
CONFIG_VFP=y
CONFIG_DEBUG_INFO=y
CONFIG_GDB_SCRIPTS=y
CONFIG_MDIO_DEVICE=y
CONFIG_PHYLIB=y
CONFIG_TMPFS=y
CONFIG_NFS_FS=y
CONFIG_ROOT_NFS=y
CONFIG_STAGING=y
CONFIG_AUTOFS_FS=y
CONFIG_CGROUPS=y
CONFIG_BPF_SYSCALL=y
CONFIG_CGROUP_BPF=y
CONFIG_IPV6=y
CONFIG_FANOTIFY=y
CONFIG_VFAT_FS=y
CONFIG_NLS_CODEPAGE_437=y
CONFIG_NLS_ISO8859_1=y
CONFIG_EXT2_FS=y
CONFIG_EXT4_FS=y
CONFIG_EXT4_FS_POSIX_ACL=y
CONFIG_EXT4_FS_SECURITY=y
CONFIG_HAS_DMA=y
CONFIG_DMADEVICES=y
CONFIG_RCM_MDMA=y
CONFIG_RCM_MGETH=y
CONFIG_RCM_MDIO=y
CONFIG_PHY_RCM_SGMII=y
CONFIG_DP83867_PHY=y
CONFIG_THERMAL=y
CONFIG_RCM_THERMAL=y
CONFIG_GPIOLIB=y
CONFIG_GPIO_SYSFS=y
CONFIG_GPIO_RCM_BC048=y

CONFIG_PCI=y
CONFIG_PCI_ENDPOINT=y
CONFIG_PCIE_CADENCE=y
CONFIG_RCM_PCIE_CADENCE_PLAT_EP=y
CONFIG_RCM_PCIE_CADENCE_PLAT_HOST=y
CONFIG_RCM_CDNS_DMA=y

#CONFIG_DEBUG_LL=y
#CONFIG_EARLY_PRINTK=y
#CONFIG_DEBUG_MUART=y
#CONFIG_DEBUG_VIRTUAL=y

CONFIG_I2C=y
CONFIG_I2C_RCM_BC048=y
CONFIG_EEPROM_AT24=y
```

## arch/arm/configs/mc127-05_defconfig
```kconfig
CONFIG_ARM=y
CONFIG_ARCH_RCM_ARM=y
CONFIG_TARGET_1879VM8YA=y
CONFIG_ARM_AMBA=y
CONFIG_MMC=y
CONFIG_SPI=y
CONFIG_SPI_MASTER=y
CONFIG_MMC_SPI=y
CONFIG_SPI_PL022=y
CONFIG_NETDEVICES=y
CONFIG_NET=y
CONFIG_ETHERNET=y
CONFIG_GRETH=y
CONFIG_PACKET=y
CONFIG_UNIX=y
CONFIG_INET=y
CONFIG_IP_PNP=y
CONFIG_IP_PNP_DHCP=y
CONFIG_IP_PNP_BOOTP=y
CONFIG_DEVTMPFS=y
CONFIG_DEVTMPFS_MOUNT=y
CONFIG_OF=y
CONFIG_OF_MDIO=y
CONFIG_HIGHMEM=y

CONFIG_EMBEDDED=y
CONFIG_VFP=y

CONFIG_DEBUG_INFO=y
CONFIG_GDB_SCRIPTS=y

CONFIG_MDIO_DEVICE=y
CONFIG_PHYLIB=y

CONFIG_TMPFS=y
CONFIG_NFS_FS=y
CONFIG_ROOT_NFS=y

CONFIG_SERIAL_PSEUDO_SPI=y

CONFIG_EASYNMC=y
CONFIG_EASYNMC_CORE_NMC3=y

CONFIG_CMA=y
CONFIG_DMA_CMA=y
CONFIG_CMA_DEBUGFS=y
CONFIG_ANDROID=y
CONFIG_STAGING=y
CONFIG_ION=y
CONFIG_ION_CMA_HEAP=y

CONFIG_AUTOFS_FS=y
CONFIG_CGROUPS=y
CONFIG_BPF_SYSCALL=y
CONFIG_CGROUP_BPF=y
CONFIG_IPV6=y
CONFIG_FANOTIFY=y
CONFIG_VFAT_FS=y
CONFIG_NLS_CODEPAGE_437=y
CONFIG_NLS_ISO8859_1=y
CONFIG_EXT2_FS=y
CONFIG_EXT4_FS=y
CONFIG_EXT4_FS_POSIX_ACL=y
CONFIG_EXT4_FS_SECURITY=y

CONFIG_THERMAL=y
CONFIG_RCM_THERMAL=y

CONFIG_PCI=y
CONFIG_PCI_ENDPOINT=y
CONFIG_PCIE_CADENCE=y
CONFIG_RCM_PCIE_CADENCE_PLAT_EP=y

CONFIG_DMA_ENGINE=y
CONFIG_DMA_OF=y
CONFIG_DMADEVICES=y
CONFIG_RCM_CDNS_DMA=y
```

## arch/arm/mach-rcm-k1879xb1/Kconfig
```kconfig
menuconfig ARCH_RCM_K1879XB1
	bool "RC Module K1879XB1YA"
	depends on MMU
	depends on ARCH_MULTI_V6
	select CPU_V6
	select ARM_TIMER_SP804
	select ARM_VIC
	select ARM_AMBA
	help
	  Support for RC Module's K1879X SoCs
if ARCH_RCM_K1879XB1

menu "K1879XB1 platform type"
config MACH_K1879XB1
	bool "K1879XB1 machine support"
	select ARM_VIC
	select GPIO_FJ
	select GPIO_PL061
	select OF
	help
	 Select this if you are using an K1879XB1 system
	 <http://www.module.ru/index.shtml>
	 
menu "Compatibility options and tuning"
config RCM_GENERIC_TIME
	depends on MACH_K1879XB1
	bool "Use generic clocksource/clockevents"
	select GENERIC_TIME
	select GENERIC_CLOCKEVENTS
	help
	 Use clocksource/clockevents instead of old-style timer implementation.
	 Clocksource-based timers have greater precision.

endmenu

menu "SDHD SoC Hardware Support"

config RCM_MVDU_CORE
	depends on MACH_K1879XB1
	depends on !UEMD_LO_MEM
	bool "MVDU video device unit platform device"
	help
	 Include MVDU platform device support

config RCM_MSVDHD_QUIRKS
	depends on MACH_K1879XB1
	bool "Enable MSVDHD video decoder DDR Quirks"

config RCM_GRI2C_HDMI
	depends on MACH_K1879XB1
	depends on I2C_OCORES
	depends on RCM_MVDU_CORE
	bool "Enable internal I2C bus used by HDMI transiever"
	help
	 UEMD board has one internal I2C bus with single device - HDMI
	 transiever. It will be accessible at index 0.

config RCM_HDMI_BI
	depends on RCM_GRI2C_HDMI
	bool "Enable I2C HDMI board info and mode switcher"
	default yes
	help
	 Enables HDMI code capable of handling TV-mode change requests
	 from video drivers like MVDU. It will change things like resolution,
	 viewport position, etc.
	 Disable this to use older i2cset-based scripts.

config RCM_TSP
	depends on MACH_K1879XB1
	bool "TSP Transport stream demultiplexer"
	help
	 Enable transport stream demultiplexor platform device. MDEMUX driver
	 should be able to handle it.

config RCM_USB
	depends on MACH_K1879XB1
	select USB_OHCI_HCD
	select USB_EHCI_HCD
	select OF
	bool "Enable USB host controller"

config RCM_AUDIO
	depends on MACH_K1879XB1
	select SND_MAUDIO
	bool "Enable MAUDIO platform device resources"

config RCM_UARTIRDA
	depends on MACH_K1879XB1
	bool "Enable UART-to-IRDA interface"
	help
	 Enable UART connected to IRDA sensor.

config RCM_SCI
	depends on MACH_K1879XB1
	bool "Enable SCI platfrom device"
	help
	 Enable SCI platform resources. msci driver should handle
	 this device.

endmenu
endmenu

endif
```

## arch/arm/mach-rcm/Kconfig
```kconfig
if ARCH_RCM_ARM

choice
	prompt "RC-Module board select"

config TARGET_1879VM8YA
	bool "Support 1879VM8YA based boards"
	select CACHE_L2X0
	select SPI
	select HAVE_PCI
	select RCM_ARM_GIC_MSI

config TARGET_1888BC048
	bool "Support 1888BC048 based boards"
	select CACHE_L2X0
	select HAVE_PCI
	select RCM_ARM_GIC_MSI

endchoice

endif
```

## arch/arm/mach-uemd/Kconfig
```kconfig
if ARCH_UEMD

comment "RC Module UEMD Platform"

menu "UEMD platform type"

config MACH_UEMD
	bool "UEMD machine support"
	select ARM_VIC
	select OF
	help
	 Select this if you are using an UEMD system
	 <http://www.module.ru/index.shtml>

menu "Compatibility options and tuning"

config UEMD_GENERIC_TIME
	depends on MACH_UEMD
	bool "Use generic clocksource/clockevents"
	select GENERIC_TIME
	select GENERIC_CLOCKEVENTS
	help
	 Use clocksource/clockevents instead of old-style timer implementation.
	 Clocksource-based timers have greater precision.


config UEMD_LO_FREQ
	depends on MACH_UEMD
	default yes
	bool "Use low-frequency mode"
	help
	 Older UEMD boards had a DDR bug and were reprogrammed to work in low 
	 frequency mode. Use this option only if you have such board.

config UEMD_LO_MEM
	depends on MACH_UEMD
	bool "Use first 16M of memory only"

endmenu

menu "SDHD SoC Hardware Support"

config MODULE_MVDU_CORE
	depends on MACH_UEMD
	depends on !UEMD_LO_MEM
	bool "MVDU video device unit platform device"
	help
	 Include MVDU platform device support

config MODULE_MSVDHD
	depends on MACH_UEMD
	select MSVDHD
	bool "MSVDHD video decoder platform device"
	help
	 Include MSVDHD platform device support


config MODULE_GRI2C_HDMI
	depends on MACH_UEMD
	depends on I2C_OCORES
	depends on MODULE_MVDU_CORE
	bool "Enable internal I2C bus used by HDMI transiever"
	help
	 UEMD board has one internal I2C bus with single device - HDMI 
	 transiever. It will be accessible at index 0.

config MODULE_HDMI_BI
	depends on MODULE_GRI2C_HDMI
	bool "Enable I2C HDMI board info and mode switcher"
	default yes
	help
	 Enables HDMI code capable of handling TV-mode change requests 
	 from video drivers like MVDU. It will change things like resolution,
	 viewport position, etc.
	 Disable this to use older i2cset-based scripts.

config MODULE_TSP
	depends on MACH_UEMD
	bool "TSP Transport stream demultiplexer"
	help
	 Enable transport stream demultiplexor platform device. MDEMUX driver 
	 should be able to handle it.

config MODULE_USB
	depends on MACH_UEMD
	select USB_OHCI_HCD
	select USB_EHCI_HCD
	bool "Enable USB host controller"

config MODULE_AUDIO
	depends on MACH_UEMD
	select SND_MAUDIO
	bool "Enable MAUDIO platform device resources"

config MODULE_UARTIRDA
	depends on MACH_UEMD
	bool "Enable UART-to-IRDA interface"
	help
	 Enable UART connected to IRDA sensor.
 
config MODULE_SCI
	depends on MACH_UEMD
	bool "Enable SCI platfrom device"
	help
	 Enable SCI platform resources. msci driver should handle 
	 this device.

endmenu
endmenu

endif
```

## arch/powerpc/configs/44x/1888bm18_defconfig
```kconfig
CONFIG_44x=y
CONFIG_EBONY=n
CONFIG_LOG_BUF_SHIFT=14
CONFIG_EXPERT=y
CONFIG_MODULES=y
CONFIG_MODULE_UNLOAD=y
CONFIG_PPC_47x=y
CONFIG_1888BM18=y
CONFIG_HZ_100=y
CONFIG_CMDLINE_BOOL=y
CONFIG_CMDLINE=""
CONFIG_NET=y
CONFIG_GRETH=y
CONFIG_PACKET=y
CONFIG_UNIX=y
CONFIG_INET=y
CONFIG_IP_PNP=y
CONFIG_IP_PNP_DHCP=y
CONFIG_IP_PNP_BOOTP=y
CONFIG_UEVENT_HELPER_PATH="/sbin/hotplug"
CONFIG_DEVTMPFS=y
CONFIG_DEVTMPFS_MOUNT=y
CONFIG_CONNECTOR=y
CONFIG_ADVANCED_OPTIONS=y
CONFIG_PHYSICAL_START_BOOL=y
CONFIG_PHYSICAL_START=0x20000000
CONFIG_NETDEVICES=y
CONFIG_VT=y
CONFIG_SERIAL_AMBA_PL011=y
CONFIG_SERIAL_AMBA_PL011_CONSOLE=y
CONFIG_SPI=y
CONFIG_SPI_PL022=y
CONFIG_GPIOLIB=y
CONFIG_GPIO_PL061=y
CONFIG_PINCTRL=y
CONFIG_PINCTRL_SINGLE=y
CONFIG_STRICT_KERNEL_RWX=y
CONFIG_EXT2_FS=y
CONFIG_EXT4_FS=y
CONFIG_EXT4_FS_POSIX_ACL=y
CONFIG_EXT4_FS_SECURITY=y
CONFIG_PROC_KCORE=y
CONFIG_TMPFS=y
CONFIG_DEBUG_INFO=y
CONFIG_PPC_EARLY_DEBUG=y
CONFIG_PPC_EARLY_DEBUG_44x_PHYSLOW=0xC0029000
CONFIG_PPC_EARLY_DEBUG_44x_PHYSHIGH=0x020
CONFIG_MMC=y
CONFIG_MMC_RCM=y
CONFIG_GPIO_SYSFS=y
CONFIG_CGROUPS=y
CONFIG_VM_EVENT_COUNTERS=n
CONFIG_SLUB_DEBUG=n
CONFIG_COREDUMP=n
CONFIG_WLAN=n
CONFIG_INPUT_MOUSE=n
CONFIG_UNIX98_PTYS=n
CONFIG_LEGACY_PTYS=n
CONFIG_DEVMEM=n
CONFIG_NVRAM=n
CONFIG_CC_OPTIMIZE_FOR_SIZE=y
CONFIG_CPU_FREQ=y
CONFIG_CPU_FREQ_RCM_1888BM18=y
CONFIG_CPU_FREQ_DEFAULT_GOV_USERSPACE=y
CONFIG_CPU_FREQ_GOV_USERSPACE=y
```
