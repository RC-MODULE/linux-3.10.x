## arch/powerpc/configs/44x/1888tx018_defconfig
```kconfig
CONFIG_44x=y
CONFIG_EBONY=n
CONFIG_SMP=y
CONFIG_NR_CPUS=2
CONFIG_SYSVIPC=y
CONFIG_POSIX_MQUEUE=y
CONFIG_LOG_BUF_SHIFT=14
CONFIG_EXPERT=y
CONFIG_KALLSYMS_ALL=y
CONFIG_PROFILING=y
CONFIG_OPROFILE=y
CONFIG_MODULES=y
CONFIG_MODULE_UNLOAD=y
CONFIG_PPC_47x=y
CONFIG_1888TX018=y
CONFIG_CPU_FREQ=y
CONFIG_CPU_FREQ_RCM_1888TX018=y
CONFIG_CPU_FREQ_DEFAULT_GOV_USERSPACE=y
CONFIG_CPU_FREQ_GOV_USERSPACE=y
CONFIG_CPU_FREQ_GOV_CONSERVATIVE=y
CONFIG_CPU_FREQ_GOV_PERFORMANCE=y
CONFIG_CPU_FREQ_GOV_ONDEMAND=y
CONFIG_CPU_FREQ_GOV_POWERSAVE=y
CONFIG_HIGHMEM=y
CONFIG_HZ_100=y
# CONFIG_MATH_EMULATION=y
CONFIG_IRQ_ALL_CPUS=y
CONFIG_CMDLINE_BOOL=y
CONFIG_CMDLINE=""
# CONFIG_SUSPEND is not set
CONFIG_NET=y
CONFIG_GRETH=y
CONFIG_PACKET=y
CONFIG_UNIX=y
CONFIG_INET=y
CONFIG_IP_PNP=y
CONFIG_IP_PNP_DHCP=y
CONFIG_IP_PNP_BOOTP=y
CONFIG_UEVENT_HELPER_PATH="/sbin/hotplug"
CONFIG_DEVTMPFS=y
CONFIG_DEVTMPFS_MOUNT=y
CONFIG_CONNECTOR=y
CONFIG_MTD=y
CONFIG_MTD_BLOCK=y
CONFIG_MTD_JEDECPROBE=y
CONFIG_MTD_CFI_INTELEXT=y
CONFIG_MTD_CFI_AMDSTD=y
CONFIG_MTD_PHYSMAP=y
CONFIG_MTD_PHYSMAP_OF=y
CONFIG_ADVANCED_OPTIONS=y
CONFIG_PAGE_OFFSET_BOOL=y
CONFIG_PAGE_OFFSET=0x80000000
CONFIG_KERNEL_START_BOOL=y
CONFIG_KERNEL_START=0x80000000
CONFIG_TASK_SIZE_BOOL=y
CONFIG_TASK_SIZE=0x80000000
CONFIG_MTD_RCM_NOR=y
CONFIG_MTD_CFI=y
CONFIG_JFFS2_FS=y
CONFIG_MTD_UBI=y
CONFIG_UBIFS_FS=y
CONFIG_BLK_DEV_RAM=y
CONFIG_BLK_DEV_RAM_SIZE=35000
CONFIG_BLK_DEV_SD=y
CONFIG_NETDEVICES=y
CONFIG_R8169=y
CONFIG_VT=y
CONFIG_SERIAL_AMBA_PL011=y
CONFIG_SERIAL_AMBA_PL011_CONSOLE=y
CONFIG_SERIAL_OF_PLATFORM=y
CONFIG_SPI=y
CONFIG_SPI_PL022=y
CONFIG_MTD_SPI_NOR=y
CONFIG_GPIOLIB=y
CONFIG_GPIO_PL061=y
CONFIG_PINCTRL=y
CONFIG_PINCTRL_SINGLE=y
CONFIG_STRICT_KERNEL_RWX=y
# CONFIG_HW_RANDOM is not set
CONFIG_I2C=y
CONFIG_I2C_OCORES=y
# CONFIG_HWMON is not set
CONFIG_THERMAL=y
CONFIG_RCM_THERMAL=y
CONFIG_USB=y
CONFIG_USB_SUPPORT=y
CONFIG_USB_EHCI_HCD=y
CONFIG_USB_OHCI_HCD=y
CONFIG_USB_MUSB_HDRC=y
CONFIG_USB_MUSB_RCM=y
CONFIG_USB_MUSB_DUAL_ROLE=y
CONFIG_USB_INVENTRA_DMA=y
CONFIG_PHY_RCM_USB=y
CONFIG_USB_GADGET=m
CONFIG_USB_MASS_STORAGE=m
CONFIG_USB_STORAGE=y
CONFIG_USB_G_SERIAL=m
CONFIG_SCSI=y
CONFIG_VFAT_FS=y
CONFIG_NLS_CODEPAGE_437=y
CONFIG_NLS_ISO8859_1=y
CONFIG_EXT2_FS=y
CONFIG_EXT4_FS=y
CONFIG_EXT4_FS_POSIX_ACL=y
CONFIG_EXT4_FS_SECURITY=y
CONFIG_PROC_KCORE=y
CONFIG_TMPFS=y
CONFIG_CRAMFS=y
CONFIG_NFS_FS=y
CONFIG_NFS_V3_ACL=y
CONFIG_NFS_V4=y
CONFIG_NLS_DEFAULT="n"
CONFIG_DEBUG_INFO=y
CONFIG_MAGIC_SYSRQ=y
CONFIG_DETECT_HUNG_TASK=y
#CONFIG_XMON=n
#CONFIG_XMON_DEFAULT=n
CONFIG_PPC_EARLY_DEBUG=y
CONFIG_PPC_EARLY_DEBUG_44x_PHYSLOW=0x3C05D000
CONFIG_PPC_EARLY_DEBUG_44x_PHYSHIGH=0x010
CONFIG_CRYPTO_CBC=y
CONFIG_CRYPTO_ECB=y
CONFIG_CRYPTO_PCBC=y
CONFIG_CRYPTO_MD5=y
CONFIG_CRYPTO_DES=y
CONFIG_CRYPTO_RCM_RMACE=y
CONFIG_CRYPTO_USER=y
CONFIG_CRYPTO_USER_API_SKCIPHER=y
CONFIG_MMC=y
CONFIG_MMC_RCM=y
CONFIG_RTC_CLASS=y
CONFIG_RTC_DRV_DS1307=y 
CONFIG_EASYNMC=y
CONFIG_EASYNMC_CORE_NMC3=y
CONFIG_EASYNMC_CORE_TEST=m
CONFIG_GPIO_SYSFS=y
CONFIG_PCI_MSI=y
CONFIG_PCI_MSI_IRQ_DOMAIN=y
CONFIG_SRAM=y
CONFIG_PCI=y
CONFIG_PCIE_RCM_NWL=y
CONFIG_MTD_NAND=y
CONFIG_MTD_RAW_NAND=y
CONFIG_MTD_RCM_NAND=y
CONFIG_DMADEVICES=y
CONFIG_RCM_RMACE_DMA=y
CONFIG_SOUND=y
CONFIG_SND=y
CONFIG_SND_SOC=y
CONFIG_SND_SOC_RCM=y
CONFIG_SND_SOC_RCM_I2S=y
CONFIG_SND_SOC_RCM_SPDIF=y
CONFIG_SND_SOC_CS4384=y
CONFIG_FB=y
CONFIG_FB_RCM_VDU=y
CONFIG_RCM_CODA_J10=y
CONFIG_MEDIA_SUPPORT=y
CONFIG_MEDIA_CAMERA_SUPPORT=y
CONFIG_V4L_PLATFORM_DRIVERS=y
CONFIG_RCM_VDU_VIDEO=y
CONFIG_DRM=y
CONFIG_DRM_RCM_VDU=y
CONFIG_DRM_I2C_ADV7511=y
CONFIG_DRM_I2C_ADV7511_CEC=y
CONFIG_RCM_VPU_CODA980=y
CONFIG_CMA=y
CONFIG_DMA_CMA=y
CONFIG_CMA_DEBUGFS=y
# CONFIG_CMA_DEBUG=y # enable for debug
CONFIG_CGROUPS=y
CONFIG_RCM_VDU_GRABBER=y
CONFIG_INPUT=y
CONFIG_INPUT_MOUSEDEV=y
CONFIG_INPUT_EVDEV=y
# [***] EasyNMC prototype
CONFIG_ANDROID=y
CONFIG_STAGING=y
CONFIG_ION=y
CONFIG_ION_CMA_HEAP=y

# [***] SATA support
CONFIG_ATA=y
CONFIG_SATA_AHCI=y

# [***] VPU CODA980 kernel V4L2 driver support
CONFIG_V4L_MEM2MEM_DRIVERS=y
CONFIG_VIDEO_CODA=m
```

## drivers/gpu/drm/rcm/Kconfig
```kconfig
menuconfig DRM_RCM_VDU
	tristate "RCM VDU KMS driver"
	depends on DRM
	select DRM_KMS_HELPER
	select DRM_KMS_CMA_HELPER
	help
	 This is a KMS driver for RCM VDU display apater.

config DRM_RCM_VDU_USE_RMACE
	bool "Using RCM RMACE for blitting"
	default y
	depends on DRM_RCM_VDU
	select RCM_RMACE
	help
	 This option activates using RCM RMACE as a DMA engine for bitting
	 in RGB565 mode.
```

## drivers/media/platform/rcm/Kconfig
```kconfig
config RCM_VDU_VIDEO
	tristate "RCM VDU video output support"
	depends on VIDEO_V4L2
	select FB_RCM_VDU_CORE
	default n
	---help---
	  Support for V4L2 interface to RCM VDU.

config RCM_VPU_CODA980
	tristate "RCM VPU CODA980 video codec driver"
	default n
	---help---
	  RCM VPU CODA980 (Chips Media) video codec driver.

config RCM_CODA_J10
	bool "RCM JPEG CODA J10 codec driver"
	default y
	---help---
	RCM JPEG CODA J10 codec driver

config RCM_VDU_GRABER
	bool "RCM VDU grab driver"
	select MEDIA_CONTROLLER
	select VIDEO_V4L2_SUBDEV_API
	select VIDEO_ADV7604
	select VIDEOBUF_GEN
	select VIDEOBUF_DMA_CONTIG
	select VIDEOBUF_VMALLOC
	select VIDEO_ADV_DEBUG
	default y
	---help---
	RCM VDU grab driver
	
```

## drivers/media/platform/uemd/Kconfig
```kconfig
config MODULE_VDU_VIDEO
	tristate "Module VDU video output support"
	depends on VIDEO_V4L2
	select MODULE_VDU_CORE
	default m
	---help---
	  Support for V4L2 interface to Module VDU.
```

## drivers/misc/rc-module/Kconfig
```kconfig
#
# RC Module specific drivers for SoC 
#

menu "RC Module SoC specific drivers"

config EASYNMC
	tristate "EasyNMC DSP Framework"
	help
      Provides a generic lowlevel interface for NeuroMatrix DSP cores 
      as found in RC Module's SoCs.

config EASYNMC_CORE_TEST
    tristate "EasyNMC Dummy Test Core"
    depends on EASYNMC
    help
      A dummy virtual test core.

config EASYNMC_CORE_NMC3
    tristate "EasyNMC NMC3 Core"
    depends on EASYNMC
    help
	  NMC3 core defined by DeviceTree.

endmenu
```

## drivers/misc/rcm/Kconfig
```kconfig
#
# RC Module specific drivers for SoC 
#

menu "RCM SoC specific drivers"

config EASYNMC
	tristate "EasyNMC DSP Framework"
	help
	  Provides a generic lowlevel interface for NeuroMatrix DSP cores 
	  as found in RC Module's SoCs.

config EASYNMC_CORE_TEST
	tristate "EasyNMC Dummy Test Core"
	depends on EASYNMC
	help
	  A dummy virtual test core.

config EASYNMC_CORE_NMC3
	tristate "EasyNMC NMC3 Core"
	depends on EASYNMC
	select MFD_SYSCON
	help
	  NMC3 core defined by DeviceTree.

config RCM_DMA_TEST
	tristate "RCM DMA Test Driver"
	depends on DMA_ENGINE
	help
	  This driver allow to test DMA devices (RC-Module implementation).

config RCM_GPIO_EXTINT
	tristate "RCM GPIO EXTINT"
	help
	  This driver allow to test interrupts from GPIO-devices.


config RCM_1879_MSVDHD
	tristate "MSVD-HD video decoder support"
	help
	  Video decoder driver for minicomputer

config RCM_RMACE
	bool
	select MFD_SYSCON

endmenu
```

## drivers/mtd/nand/Kconfig
```kconfig
config MTD_NAND_CORE
	tristate

source "drivers/mtd/nand/onenand/Kconfig"

source "drivers/mtd/nand/raw/Kconfig"


config MTD_RCM_NAND
    tristate "RC-Module SoC NAND support"
    depends on 1888TX018
    help
        Support for NAND flash attached to the 1888TX018 SoC's
```

## drivers/net/ethernet/aeroflex/Kconfig
```kconfig
#
# Aeroflex Gaisler network device configuration
#

config GRETH
	tristate "Aeroflex Gaisler GRETH Ethernet MAC support"
	depends on SPARC || ARM
	select PHYLIB
	select CRC32
	---help---
	  Say Y here if you want to use the Aeroflex Gaisler GRETH Ethernet MAC.
```

## drivers/net/ethernet/rcm/Kconfig
```kconfig
#
# Ethernet drivers for RC Module platforms
#
config RCM_MGETH
	bool "RC-Module MGETH Ethernet controller"
	select RCM_SGMII_PHY
	select RCM_MDIO
	select GENERIC_IRQ_CHIP
	select DMADEVICES
	select RCM_MDMA_DESC_POOL
	help
	  This driver supports the RC-Module based MGETH Ethernet controller.

config RCM_MDIO
	bool "RC-Module MDIO Support"
	select PHYLIB
	select PINCTRL
	select PINCTRL_SINGLE
	help
	  This driver supports RC-Module MDIO module.
```

## drivers/pci/controller/cadence/Kconfig
```kconfig
# SPDX-License-Identifier: GPL-2.0

menu "Cadence PCIe controllers support"
	depends on PCI

config PCIE_CADENCE
	bool

config PCIE_CADENCE_HOST
	bool
	depends on OF
	select IRQ_DOMAIN
	select PCIE_CADENCE

config PCIE_CADENCE_EP
	bool
	depends on OF
	depends on PCI_ENDPOINT
	select PCIE_CADENCE

config PCIE_CADENCE_PLAT
	bool

config PCIE_CADENCE_PLAT_HOST
	bool "Cadence PCIe platform host controller"
	depends on OF
	select PCIE_CADENCE_HOST
	select PCIE_CADENCE_PLAT
	help
	  Say Y here if you want to support the Cadence PCIe platform controller in
	  host mode. This PCIe controller may be embedded into many different
	  vendors SoCs.

config PCIE_CADENCE_PLAT_EP
	bool "Cadence PCIe platform endpoint controller"
	depends on OF
	depends on PCI_ENDPOINT
	select PCIE_CADENCE_EP
	select PCIE_CADENCE_PLAT
	help
	  Say Y here if you want to support the Cadence PCIe  platform controller in
	  endpoint mode. This PCIe controller may be embedded into many
	  different vendors SoCs.

config RCM_PCIE_CADENCE
	bool

config RCM_PCIE_CADENCE_HOST
	bool
	depends on OF
	select IRQ_DOMAIN
	select PCIE_CADENCE
	select RCM_PCIE_CADENCE

config RCM_PCIE_CADENCE_EP
	bool
	depends on OF
	depends on PCI_ENDPOINT
	select PCIE_CADENCE
	select RCM_PCIE_CADENCE

config RCM_PCIE_CADENCE_PLAT
	bool

config RCM_PCIE_CADENCE_PLAT_HOST
	bool "Cadence PCIe platform host controller (RCM implementation)"
	depends on OF
	select RCM_PCIE_CADENCE_HOST
	select RCM_PCIE_CADENCE_PLAT
	help
	  Say Y here if you want to support the Cadence PCIe platform controller
	  (in host mode) embedded into RCM SoC.

config RCM_PCIE_CADENCE_PLAT_EP
	bool "Cadence PCIe platform endpoint controller (RCM implementation)"
	depends on OF
	depends on PCI_ENDPOINT
	select RCM_PCIE_CADENCE_EP
	select RCM_PCIE_CADENCE_PLAT
	help
	  Say Y here if you want to support the Cadence PCIe  platform controller 
	  (in endpoint mode) embedded into RCM SoC.

endmenu
```

## drivers/phy/rcm/Kconfig
```kconfig
#
# Phy drivers for RC Module platforms
#
config PHY_RCM_USB
	tristate "RCM USB PHY driver"
	depends on PPC
	select GENERIC_PHY
	select USB_PHY
	help
	  Support for USB PHY found on RCM PPC SoCs.

config PHY_RCM_SGMII
	tristate "RCM SGMII PHY driver"
	depends on ARCH_RCM_ARM
	select GENERIC_PHY
	select REGMAP_MMIO
	select MFD_SYSCON
	help
	  Support for SBMII PHY device on RCM SoCs.
```

## drivers/phy/rcmodule/Kconfig
```kconfig
#
# Phy drivers for RC Module platforms
#
config PHY_RCMODULE_USB
	tristate "RC Module USB PHY driver"
	depends on PPC
	select GENERIC_PHY
	select USB_PHY
	help
	  Support for USB PHY found on RC Module PPC SoCs.
```

## drivers/video/fbdev/rcm/Kconfig
```kconfig
config FB_RCM_VDU_CORE
	tristate
	default n

config FB_RCM_VDU
	tristate "RCM VDU framebuffer support"
	default n
	depends on FB
	select FB_RCM_VDU_CORE
	select FB_SYS_FILLRECT
	select FB_SYS_COPYAREA
	select FB_SYS_IMAGEBLIT
```

## sound/arm/Kconfig
```kconfig
# ALSA ARM drivers

menuconfig SND_ARM
	bool "ARM sound devices"
	depends on ARM
	default y
	help
	  Support for sound devices specific to ARM architectures.
	  Drivers that are implemented on ASoC can be found in
	  "ALSA for SoC audio support" section.

if SND_ARM

config SND_ARMAACI
	tristate "ARM PrimeCell PL041 AC Link support"
	depends on ARM_AMBA
	select SND_PCM
	select SND_AC97_CODEC

config SND_PXA2XX_PCM
	tristate
	select SND_PCM

config SND_PXA2XX_AC97
	tristate "AC97 driver for the Intel PXA2xx chip"
	depends on ARCH_PXA
	select SND_PXA2XX_PCM
	select SND_AC97_CODEC
	select SND_PXA2XX_LIB
	select SND_PXA2XX_LIB_AC97
	help
	  Say Y or M if you want to support any AC97 codec attached to
	  the PXA2xx AC97 interface.

config SND_MAUDIO
       tristate "RC Module Audio Interface"
       depends on OF
       select SND_PCM

config SND_MAUDIO_DEBUG
       bool "Enable MAUDIO driver debug facilities"
       default n
       depends on SND_MAUDIO
       help
         Say Y to enable driver-specific debugfs entries. User will be able to
         view irq status history and HW DMA pointers. These have much smaller
         impact on a system comparing to maudio's debug parameter set to 1.
         Debugfs folder will be called maudio.

endif	# SND_ARM

config SND_PXA2XX_LIB
	tristate
	select SND_AC97_CODEC if SND_PXA2XX_LIB_AC97
	select SND_DMAENGINE_PCM

config SND_PXA2XX_LIB_AC97
	bool
```

## sound/soc/rcm/Kconfig
```kconfig
config SND_SOC_RCM
	tristate "Audio support for RC Module reference designs"
	depends on 1888TX018 || COMPILE_TEST
	select SND_SOC_SPDIF
	select SND_SIMPLE_CARD
	help
	  Audio support for reference designs by RC Module.

config SND_SOC_RCM_I2S
	tristate "I2S support"
	depends on SND_SOC_RCM
	select REGMAP_MMIO
	select RCM_AUDIO_DMA
	select SND_SOC_GENERIC_DMAENGINE_PCM
	help
	  Driver for 1888TX018 SoC I2S subsystem.

config SND_SOC_RCM_SPDIF
	tristate "SPDIF support"
	depends on SND_SOC_RCM
	select REGMAP_MMIO
	select RCM_AUDIO_DMA
	select SND_SOC_GENERIC_DMAENGINE_PCM
	help
	  Driver for 1888TX018 SoC SPDIF subsystem.
```
